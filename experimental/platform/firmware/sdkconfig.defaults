## experimental/platform/firmware/sdkconfig.defaults
```kconfig
CONFIG_IDF_TARGET="esp32s3"
CONFIG_ESPTOOLPY_FLASHSIZE_16MB=y
CONFIG_FREERTOS_UNICORE=y
CONFIG_ESP_DEFAULT_CPU_FREQ_MHZ_240=y
CONFIG_ESP_CONSOLE_UART_DEFAULT=y
CONFIG_ESP_MAIN_TASK_STACK_SIZE=8192
CONFIG_COMPILER_OPTIMIZATION_PERF=y
```

## firmware/components/pao/Kconfig.projbuild
```kconfig
config PAO_QEMU_NETWORK
    bool "Use OpenETH transport for the PAO board in QEMU"
    default n
    select ETH_USE_OPENETH
```

## firmware/simulation/sdkconfig.defaults
```kconfig
CONFIG_PAO_QEMU_NETWORK=y
CONFIG_ESP_DEFAULT_CPU_FREQ_MHZ_80=y
CONFIG_SPIRAM_MEMTEST=n
CONFIG_MBEDTLS_HARDWARE_AES=n
CONFIG_MBEDTLS_HARDWARE_SHA=n
CONFIG_USE_AFE_WAKE_WORD=y
CONFIG_SR_WN_WN9_NIHAOXIAOZHI_TTS=y
```
